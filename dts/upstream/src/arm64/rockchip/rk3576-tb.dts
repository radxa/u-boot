// SPDX-License-Identifier: (GPL-2.0+ OR MIT)
/*
 * Copyright (c) 2026 Rockchip Electronics Co., Ltd.
 */

/dts-v1/;

#include <dt-bindings/input/input.h>
#include "rk3576.dtsi"

/ {
	model = "Rockchip RK3576 fastboot board";
	compatible = "rockchip,rk3576-evb", "rockchip,rk3576";

	chosen {
		stdout-path = "serial0:1500000n8";
	};
};

&sdhci {
	bus-width = <8>;
	status = "okay";
};
