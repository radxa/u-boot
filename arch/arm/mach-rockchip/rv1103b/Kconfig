## arch/arm/mach-rockchip/rv1103b/Kconfig
```kconfig
if ROCKCHIP_RV1103B

config TARGET_EVB_RV1103B
	bool "EVB_RV1103B"
	select BOARD_LATE_INIT
	help
	  RV1103B EVB is a evaluation board for Rockchip RV1103B.

config ROCKCHIP_BOOT_MODE_REG
	default 0x20160200

config ROCKCHIP_STIMER_BASE
	default 0x20500000

config SOC_SPECIFIC_OPTIONS # dummy
	def_bool y
	select HAS_CUSTOM_SYS_INIT_SP_ADDR

config CUSTOM_SYS_INIT_SP_ADDR
	default 0x00400000

config SPL_STACK
	default 0x03de0000

config SPL_MAX_SIZE
	default 0x40000

config SPL_BSS_START_ADDR
	default 0x03de0000

config SPL_BSS_MAX_SIZE
	default 0x20000

config TEXT_BASE
	default 0x00200000

config SYS_LOAD_ADDR
	default 0x00008000

config SYS_MALLOC_F_LEN
	default 0x80000

config SYS_SOC
	default "rockchip"

source board/rockchip/evb_rv1103b/Kconfig

endif
```

## board/sunxi/Kconfig
```kconfig
menu "sunxi board feature"


config SUNXI_MALLOC_LEN
	hex "sunxi_malloc_len"
	default 0x4000000
	help
		when enabled, uboot set init malloc len

config SUNXI_MAC
	bool "sunxi_mac"
	default n
	help
		when enabled, uboot read mac addr and send to system via cmdline

config SUNXI_GPIO_POWER_VOL_MODE
	bool "power mode of gpio"
	default n
	help
		when enabled, the voltage of gpio to set normal according to extern voltage

config SUNXI_USER_KEY
	bool "user key"
	default n
	select SUNXI_SECURE_STORAGE
	select CMD_FAT
	help
		when enable, uboot try to read cmdline data from secure storage

config SUNXI_FAST_BURN_KEY
	bool "sunxi fast burn key enable"
	default y
	depends on !MACH_SUN8IW18 && !MACH_SUN8IW7 && !MACH_SUN50IW3 && !MACH_SUN50IW6 && !SUNXI_UBIFS
	depends on SUNXI_BURN

config SUNXI_DRM_SUPPORT
	bool "drm support"
	default n
	help
		when enable, uboot set up drm related configurate

config SUNXI_EXTERN_SECURE_MM_LAYOUT
	bool "sunxi secure memory lay defined in fdt"
	default n
	help
		when enable, uboot try to load secure memory layout
		from fdt(shm\ta ram). Notify secure os configurated
		layout and mard those memory as "reserved memory" in
		fdt

config SUNXI_ADVERT_PICTURE
	bool "advert logo"
	default n
	depends on BOOT_GUI
	help
		when enable, uboot will try to use logo in reserve0, witch can be modified by APPS

config SUNXI_ANTI_COPY_BOARD
	bool "sunxi anti copy board"
	default n
	select SUNXI_SECURE_STORAGE
	help
		when enable, uboot will verify the board.

config SUNXI_VERIFY_DSP
	bool "sunxi verify dsp"
	default y
	depends on XTENSA_DSP
	depends on SUNXI_SECURE_BOOT
	help
		when enable, uboot will verify the dsp bin.

config SUNXI_VERIFY_RV
	bool "sunxi verify rv"
	default n
	depends on BOOT_RISCV
	help
		when enable, uboot will verify the rv bin.


config SUNXI_IMAGE_HEADER
	bool "sunxi verify with image header"
	default n
	help
		when enable, uboot will verify with image header.

menuconfig SUNXI_ANDROID_BOOT
	bool "android boot sequence"
	default n
	imply SUNXI_AVB
	help
		boot seqquence requeseted by AOSP: GREEN YELLOW ORANGE RED, etc

if SUNXI_ANDROID_BOOT
config LIBAVB
	bool "android avb support lib"
	default n
	help
		library for Android verified Boot

config SUNXI_AVB
	bool "sunxi support for android verify boot"
	default n
	select LIBAVB
	help
		support android verify boot sequence in sunxi board

config SUNXI_VERIFY_BOOT_INFO_INSTALL
	bool "install verify boot info for android keymaster"
	default n
	help
		select this, uboot will store verify boot info to optee, for keymaster to read

endif

menuconfig SUNXI_CHECK_LIMIT_VERIFY
	bool "sunxi support cpu/gpu freq limit"
	default n
	help
		sunxi support cpu/gpu freq limit
if SUNXI_CHECK_LIMIT_VERIFY

config SUNXI_LIMIT_CPU_FREQ
	bool "sunxi cpu freq limit"

config SUNXI_LIMIT_GPU_FREQ
	bool "sunxi gpu freq limit"

endif

config SUNXI_MIPS
	bool "sunxi mips loading support"
	default n

config SUNXI_SWITCH_SYSTEM
	bool "Sunxi switch system"
	default n
	select BOOTCOUNT_LIMIT
	select BOOTCOUNT_ENV
	help
	    Supports automatic switching and damaged switching

config SUNXI_UPDATE_REMIND
	bool "sunxi support update remind"
	default n
	help
	    Support reminder after mass production

config SUNXI_REPLACE_FDT_FROM_PARTITION
	bool "Replace current fdt data"
	default n
	depends on OF_SEPARATE
	help
	    Get fdt data from raw partition or fat filesystem partition
	    to replace current fdt data

config SUNXI_NECESSARY_REPLACE_FDT
	bool "Replace current fdt data v2"
	default n
	depends on OF_SEPARATE
	help
	    Get fdt data from dtb.img, boot.img or vendor_boot.img
	    to replace current fdt data v2

config SUN50IW9_AUTOPRINT
	bool "Open print mode check"
	default n
	help
	    check card print and uart print,write auto_print

config SUNXI_KASLR_SEED
	bool "sunxi support kaslr seed"
	default n
	depends on SUNXI_CE_DRIVER
	help
	    Use TRNG to generate random numbers and update
	    them to the kernel device tree

config SUNXI_LRADC_VOL
	bool "sunxi support lradc read voltage"
	default n
	depends on SUNXI_LRADC
	help
	    Support lradc read voltage in uboot which can be used to
	    choose sensor through different voltages.

config BOOTCMD_SKIP_MISC
	bool "sunxi skip detect misc for bootcmd"
	default n
	help
		skip detect misc for bootcmd

config BOOTCMD_SKIP_ADCKEY
	bool "sunxi skip detect adckey for bootcmd"
	default n
	help
		skip detect adckey for bootcmd

config BOOTCMD_SKIP_RTC
	bool "sunxi skip detect rtc for bootcmd"
	default n
	help
		skip detect rtc for bootcmd

menuconfig SUNXI_HOMLET
	bool "sunxi homlet support"
	default n
	help
		features for homle product

if SUNXI_HOMLET
config SUNXI_BOX_STANDBY
	bool "box standby"
	default n

config ATF_BOX_STANDBY
	bool "atf box standby"
	default n

config IR_BOOT_RECOVERY
	bool "support ir remote control"
	default n
	select SUNXI_IR

config RECOVERY_KEY
	bool "support recovery key"
	default n

config SUNXI_HDCP_KEY_RX
	bool "hdcp key receive process"
	default n
	help
			hdcp key sent or receive select

config HDCP_DEBUG
	bool "hdcp key debug support"
	default n
	help
		support write hdcphash to efuse

config SUNXI_HDCP_IN_SECURESTORAGE
	bool "hdcp key support"
	default n
	select SUNXI_KEYBOX
	imply SUNXI_HDCP_HASH
	help
		support hdcp key

config SUNXI_CHECK_CUSTOMER_RESERVED_ID
	bool "check customer reserved id"
	default n
	help
		support check customer reserved id
config SUNXI_CUSTOMER_RESERVED_ID_ENABLE
	bool "fill customer reserved id"
	depends on SUNXI_CHECK_CUSTOMER_RESERVED_ID
	default n
	help
		support software to write customer reserved id
config SUNXI_CUSTOMER_RESERVED_ID
	hex "set customer reserved id value"
	depends on SUNXI_CUSTOMER_RESERVED_ID_ENABLE
	default 0
	help
		set customer reserved id value

config START_MODE_RTC_REG_INDEX
	hex "homtlet/tv boot mode reg"
	default 0x2
	---help---
	specific reg stored homtlet/tv start mode flag

if SUNXI_HDCP_IN_SECURESTORAGE
config SUNXI_HDCP_HASH
	bool "hdcp key hash process"
	default n
	help
		store hdcp key hash for key usage

endif

endif

choice
	prompt "sunxi image compression type"
	default SUNXI_COMP_NONE

config SUNXI_COMP_NONE
	bool "none"
	help
		Image use none compression type

config SUNXI_COMP_GZ
	bool "gzip"
	help
		Image use gzip compression type

config SUNXI_COMP_DETECT
        bool "auto detect"
	help
		Auto detect image compression type

endchoice

choice
	prompt "rotpk burn on sprite"
	default SUNXI_NOT_BURN_ROTPK

config SUNXI_NOT_BURN_ROTPK
	bool "do not burn"

config SUNXI_BURN_ROTPK_ON_SPRITE
	bool "always burn"
	depends on SUNXI_CE_DRIVER
	help
		Burn rotpk before set secure bit to 1

config SUNXI_ROTPK_BURN_ENABLE_BY_TOOL
	bool "tool enable"
	depends on SUNXI_CE_DRIVER
	help
		if tool do not specific, do not burn

endchoice

config SUNXI_SET_EFUSE_POWER
	bool "set sunxi efuse power"
	depends on SUNXI_PMU
	default n
	help
		Efuse is powered by the pmu.

config SUNXI_ENABLE_FEL_VERIFY
	bool "enable sunxi sign fel verify"
	default n
	help
		Burn efuse sign fel bit

config SUNXI_FPGA_PLATFORM
	bool "build for fpga platform"
	help
		fpga board have special treament for resources like
		clock or io, this config enable thoes special treament

config SUNXI_TRACE
	bool "enable trace feature"
	help
		trace feature based on origin TRACE
config SUNXI_MEM_INFO
        bool "sunxi memory info"
        default y
        help
           enable memory information

config SUNXI_NSI_PRIO_INIT
	bool "sunxi nsi init"
	select SUNXI_NSI_DRV
	default n
	help
		init nsi masters priority in u-boot

config SUNXI_RKP
	bool "sunxi rkp extraction"
	default n
	depends on SUNXI_AVB
	help
		support rkp device extraction

config SUNXI_RNG_SEED
	bool "sunxi enable fill rng-seed contents"
	default n
	help
	   Bootloader provide randomness and the value is read from /chosen/rng-seed in DT

if SUNXI_RKP
config SUNXI_RKP_FROM_UBOOT
	bool "support build rkp csr in uboot"
	imply LIB_OPENDICE
	help
		require external open-dice lib
endif

config SUNXI_PRINTF_TSTAMP_DISABLE
	bool "support disable printf time stamp in uboot"
	help
		disable printf time stamp
endmenu
```

## configs/genio_720_evk_ufs_defconfig
```kconfig
CONFIG_ARM=y
CONFIG_SYS_BOARD="genio-720-evk"
CONFIG_COUNTER_FREQUENCY=13000000
CONFIG_POSITION_INDEPENDENT=y
CONFIG_ARCH_MEDIATEK=y
CONFIG_SYS_TEXT_BASE=0x4c000000
CONFIG_SYS_MALLOC_LEN=0x500000
CONFIG_SYS_MALLOC_F_LEN=0x4000
CONFIG_NR_DRAM_BANKS=1
CONFIG_ENV_SIZE=0x2000
CONFIG_ENV_OFFSET=0x0
CONFIG_DM_GPIO=y
CONFIG_DEFAULT_DEVICE_TREE="genio-720-evk-ufs"
CONFIG_TARGET_MT8391=y
CONFIG_DEBUG_UART_BASE=0x11001000
CONFIG_DEBUG_UART_CLOCK=26000000
CONFIG_ARMV8_CRYPTO=y
CONFIG_SYS_LOAD_ADDR=0x4c000000
CONFIG_DEBUG_UART=y
CONFIG_DISTRO_DEFAULTS=y
CONFIG_FIT=y
CONFIG_FIT_SIGNATURE=y
CONFIG_LEGACY_IMAGE_FORMAT=y
CONFIG_OF_BOARD_SETUP=y
CONFIG_DEFAULT_FDT_FILE="mt8391-genio-720-evk-ufs"
# CONFIG_DISPLAY_BOARDINFO is not set
CONFIG_BOARD_LATE_INIT=y
# CONFIG_CMD_CONSOLE is not set
# CONFIG_CMD_BOOTD is not set
CONFIG_SYS_BOOTM_LEN=0x5000000
CONFIG_CMD_BOOTEFI_SELFTEST=y
# CONFIG_CMD_ELF is not set
# CONFIG_CMD_GO is not set
# CONFIG_CMD_IMI is not set
# CONFIG_CMD_XIMG is not set
CONFIG_CMD_NVEDIT_EFI=y
CONFIG_CMD_NVEDIT_INFO=y
# CONFIG_CMD_CRC32 is not set
CONFIG_CMD_CLK=y
CONFIG_CMD_DFU=y
CONFIG_CMD_DM=y
CONFIG_CMD_GPIO=y
CONFIG_CMD_GPT=y
CONFIG_CMD_GPT_RENAME=y
CONFIG_CMD_I2C=y
# CONFIG_CMD_LOADB is not set
# CONFIG_CMD_LOADS is not set
CONFIG_CMD_MBR=y
CONFIG_CMD_MMC=y
CONFIG_CMD_UFS=y
# CONFIG_CMD_ITEST is not set
CONFIG_CMD_BMP=y
# CONFIG_CMD_BLOCK_CACHE is not set
CONFIG_CMD_EFIDEBUG=y
CONFIG_PARTITION_TYPE_GUID=y
CONFIG_ENV_IS_IN_SCSI=y
CONFIG_SYS_SCSI_ENV_DEV=1
CONFIG_ENV_VARS_UBOOT_RUNTIME_CONFIG=y
CONFIG_ENV_IMPORT_FDT=y
CONFIG_REGMAP=y
CONFIG_SYSCON=y
CONFIG_DEVRES=y
CONFIG_CLK=y
CONFIG_DFU_MMC=y
CONFIG_DFU_UFS=y
CONFIG_SYS_DFU_DATA_BUF_SIZE=0x100000
CONFIG_SYS_DFU_MAX_FILE_SIZE=0x200000
CONFIG_DM_I2C=y
CONFIG_SYS_I2C_MTK=y
# CONFIG_INPUT is not set
CONFIG_MISC=y
# CONFIG_MMC_QUIRKS is not set
CONFIG_MMC_MTK=y
CONFIG_PHY_AIROHA=y
CONFIG_PHY_AIROHA_AN8801=y
CONFIG_PHY_ETHERNET_ID=y
CONFIG_DWC_ETH_QOS=y
CONFIG_DWC_ETH_QOS_MTK=y
CONFIG_PHY=y
CONFIG_PHY_MTK_TPHY=y
CONFIG_PINCTRL=y
CONFIG_PINCONF=y
CONFIG_PINCTRL_MT8189=y
CONFIG_POWER_DOMAIN=y
CONFIG_MTK_POWER_DOMAIN=y
CONFIG_DM_PMIC=y
CONFIG_MTK_PMIC_WRAP=y
CONFIG_DM_REGULATOR=y
CONFIG_DM_REGULATOR_FIXED=y
CONFIG_DM_REGULATOR_MT6359=y
CONFIG_DM_RTC=y
CONFIG_RTC_EMULATION=y
CONFIG_SCSI=y
CONFIG_DM_SCSI=y
CONFIG_BAUDRATE=921600
CONFIG_DM_SERIAL=y
CONFIG_DEBUG_UART_ANNOUNCE=y
CONFIG_MTK_SERIAL=y
CONFIG_SPI=y
CONFIG_DM_SPI=y
CONFIG_MTK_SPIM=y
CONFIG_SYSRESET=y
CONFIG_SYSRESET_PSCI=y
CONFIG_UFS=y
CONFIG_UFS_MEDIATEK=y
CONFIG_WDT=y
CONFIG_ERRNO_STR=y
CONFIG_OF_LIBFDT_OVERLAY=y
CONFIG_EFI_SET_TIME=y
CONFIG_EFI_RUNTIME_UPDATE_CAPSULE=y
CONFIG_EFI_CAPSULE_ON_DISK=y
CONFIG_EFI_IGNORE_OSINDICATIONS=y
CONFIG_EFI_CAPSULE_FIRMWARE_RAW=y
CONFIG_EFI_CAPSULE_AUTHENTICATE=y
CONFIG_LMB_MAX_REGIONS=16
CONFIG_SYSINFO=y
# CONFIG_SYSINFO_GAZERBEAM is not set
# CONFIG_SYSINFO_SANDBOX is not set
CONFIG_SYSINFO_SMBIOS=y
# CONFIG_SYSINFO_GPIO is not set
```

## configs/genio_720_evk_ufs_qspi_defconfig
```kconfig
CONFIG_ARM=y
CONFIG_SYS_BOARD="genio-720-evk"
CONFIG_COUNTER_FREQUENCY=13000000
CONFIG_POSITION_INDEPENDENT=y
CONFIG_ARCH_MEDIATEK=y
CONFIG_SYS_TEXT_BASE=0x4c000000
CONFIG_SYS_MALLOC_LEN=0x500000
CONFIG_SYS_MALLOC_F_LEN=0x4000
CONFIG_NR_DRAM_BANKS=1
CONFIG_ENV_SIZE=0x2000
CONFIG_ENV_OFFSET=0xd80000
CONFIG_ENV_SECT_SIZE=0x10000
CONFIG_DM_GPIO=y
CONFIG_DEFAULT_DEVICE_TREE="genio-720-evk-ufs-qspi"
CONFIG_TARGET_MT8391=y
CONFIG_DEBUG_UART_BASE=0x11001000
CONFIG_DEBUG_UART_CLOCK=26000000
CONFIG_ARMV8_CRYPTO=y
CONFIG_SYS_LOAD_ADDR=0x4c000000
CONFIG_DEBUG_UART=y
CONFIG_DISTRO_DEFAULTS=y
CONFIG_FIT=y
CONFIG_FIT_SIGNATURE=y
CONFIG_LEGACY_IMAGE_FORMAT=y
CONFIG_OF_BOARD_SETUP=y
CONFIG_DEFAULT_FDT_FILE="mt8391-genio-720-evk-ufs"
# CONFIG_DISPLAY_BOARDINFO is not set
CONFIG_BOARD_LATE_INIT=y
# CONFIG_CMD_CONSOLE is not set
# CONFIG_CMD_BOOTD is not set
CONFIG_SYS_BOOTM_LEN=0x5000000
CONFIG_CMD_BOOTEFI_SELFTEST=y
# CONFIG_CMD_ELF is not set
# CONFIG_CMD_GO is not set
# CONFIG_CMD_IMI is not set
# CONFIG_CMD_XIMG is not set
CONFIG_CMD_NVEDIT_EFI=y
CONFIG_CMD_NVEDIT_INFO=y
# CONFIG_CMD_CRC32 is not set
CONFIG_CMD_CLK=y
CONFIG_CMD_DFU=y
CONFIG_CMD_DM=y
CONFIG_CMD_GPIO=y
CONFIG_CMD_GPT=y
CONFIG_CMD_GPT_RENAME=y
CONFIG_CMD_I2C=y
# CONFIG_CMD_LOADB is not set
# CONFIG_CMD_LOADS is not set
CONFIG_CMD_MBR=y
CONFIG_CMD_MMC=y
CONFIG_CMD_MTD=y
CONFIG_CMD_UFS=y
# CONFIG_CMD_ITEST is not set
CONFIG_CMD_BMP=y
# CONFIG_CMD_BLOCK_CACHE is not set
CONFIG_CMD_EFIDEBUG=y
CONFIG_CMD_MTDPARTS=y
CONFIG_MTDIDS_DEFAULT="nor0=nor0"
CONFIG_MTDPARTS_DEFAULT="mtdparts=nor0:2m(nor_bl2),2m(nor_fip_a),2m(nor_fip_b),2m(nor_firmware_a),2m(nor_firmware_b),512k(nor_dramk),1m(nor_misc),2m(nor_bootassets),2m(nor_env)"
CONFIG_CMD_UBI=y
CONFIG_PARTITION_TYPE_GUID=y
CONFIG_ENV_IS_IN_SPI_FLASH=y
CONFIG_ENV_VARS_UBOOT_RUNTIME_CONFIG=y
CONFIG_ENV_IMPORT_FDT=y
CONFIG_REGMAP=y
CONFIG_SYSCON=y
CONFIG_DEVRES=y
CONFIG_CLK=y
CONFIG_DFU_MMC=y
CONFIG_DFU_MTD=y
CONFIG_DFU_UFS=y
CONFIG_SYS_DFU_DATA_BUF_SIZE=0x100000
CONFIG_SYS_DFU_MAX_FILE_SIZE=0x200000
CONFIG_DM_I2C=y
CONFIG_SYS_I2C_MTK=y
# CONFIG_INPUT is not set
CONFIG_MISC=y
# CONFIG_MMC_QUIRKS is not set
CONFIG_MMC_MTK=y
CONFIG_MTD=y
CONFIG_DM_MTD=y
CONFIG_DM_SPI_FLASH=y
CONFIG_SPI_FLASH_SFDP_SUPPORT=y
CONFIG_SPI_FLASH_EON=y
CONFIG_SPI_FLASH_GIGADEVICE=y
CONFIG_SPI_FLASH_ISSI=y
CONFIG_SPI_FLASH_MACRONIX=y
CONFIG_SPI_FLASH_SPANSION=y
CONFIG_SPI_FLASH_STMICRO=y
CONFIG_SPI_FLASH_WINBOND=y
# CONFIG_SPI_FLASH_USE_4K_SECTORS is not set
CONFIG_SPI_FLASH_MTD=y
CONFIG_PHY_AIROHA=y
CONFIG_PHY_AIROHA_AN8801=y
CONFIG_PHY_ETHERNET_ID=y
CONFIG_DWC_ETH_QOS=y
CONFIG_DWC_ETH_QOS_MTK=y
CONFIG_PHY=y
CONFIG_PHY_MTK_TPHY=y
CONFIG_PINCTRL=y
CONFIG_PINCONF=y
CONFIG_PINCTRL_MT8189=y
CONFIG_POWER_DOMAIN=y
CONFIG_MTK_POWER_DOMAIN=y
CONFIG_DM_PMIC=y
CONFIG_MTK_PMIC_WRAP=y
CONFIG_DM_REGULATOR=y
CONFIG_DM_REGULATOR_FIXED=y
CONFIG_DM_REGULATOR_MT6359=y
CONFIG_DM_RTC=y
CONFIG_RTC_EMULATION=y
CONFIG_SCSI=y
CONFIG_DM_SCSI=y
CONFIG_BAUDRATE=921600
CONFIG_DM_SERIAL=y
CONFIG_DEBUG_UART_ANNOUNCE=y
CONFIG_MTK_SERIAL=y
CONFIG_SPI=y
CONFIG_DM_SPI=y
CONFIG_MTK_SNOR=y
CONFIG_SYSRESET=y
CONFIG_SYSRESET_PSCI=y
CONFIG_UFS=y
CONFIG_UFS_MEDIATEK=y
CONFIG_WDT=y
CONFIG_ERRNO_STR=y
CONFIG_OF_LIBFDT_OVERLAY=y
CONFIG_EFI_SET_TIME=y
CONFIG_EFI_RUNTIME_UPDATE_CAPSULE=y
CONFIG_EFI_CAPSULE_ON_DISK=y
CONFIG_EFI_IGNORE_OSINDICATIONS=y
CONFIG_EFI_CAPSULE_FIRMWARE_RAW=y
CONFIG_EFI_CAPSULE_AUTHENTICATE=y
CONFIG_LMB_MAX_REGIONS=16
CONFIG_SYSINFO=y
# CONFIG_SYSINFO_GAZERBEAM is not set
# CONFIG_SYSINFO_SANDBOX is not set
CONFIG_SYSINFO_SMBIOS=y
# CONFIG_SYSINFO_GPIO is not set
```
