// SPDX-License-Identifier: (GPL-2.0+ OR MIT)
/*
 * Copyright (c) 2018 Fuzhou Rockchip Electronics Co., Ltd
 * Copyright (c) 2026 Radxa Computer (Shenzhen) Co., Ltd.
 */

/dts-v1/;
#include "rk3308-radxa-rcore-rk3308.dtsi"

/ {
	model = "Radxa rCore-RK3308 IO";
	compatible = "radxa,rcore-rk3308-io", "radxa,rcore-rk3308", "rockchip,rk3308";
};
