// SPDX-License-Identifier: (GPL-2.0+ OR MIT)
/*
 * Copyright (c) 2021 Rockchip Electronics Co., Ltd
 * Copyright (c) 2024 Radxa Computer (Shenzhen) Co., Ltd.
 *
 */

/dts-v1/;
#include "rk3588.dtsi"
#include "rk3588-u-boot.dtsi"
#include <dt-bindings/input/input.h>

/ {
	model = "Radxa E54C";
	compatible = "radxa,e54c", "rockchip,rk3588";
};

/* M.2 M-KEY PCIe */
&combphy0_ps {
	status = "okay";
};

&pcie2x1l2 {
	status = "okay";
	reset-gpios = <&gpio3 RK_PD1 GPIO_ACTIVE_HIGH>;
};
