// SPDX-License-Identifier: (GPL-2.0+ OR MIT)
/*
 * Copyright (c) 2023 Rockchip Electronics Co., Ltd.
 * Copyright (c) 2024 Radxa Computer (Shenzhen) Co., Ltd.
 */

/dts-v1/;
#include "rk3576-radxa-cm4.dtsi"

/ {
	model = "Radxa CM4 RPI CM4 IO Board";
	compatible = "radxa,cm4-rpi-cm4-io", "radxa,cm4", "rockchip,rk3576";
};
