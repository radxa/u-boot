## board/rockchip/evb_rv1103b/Kconfig
```kconfig
if TARGET_EVB_RV1103B

config SYS_BOARD
	default "evb_rv1103b"

config SYS_VENDOR
	default "rockchip"

config SYS_CONFIG_NAME
	default "evb_rv1103b"

config BOARD_SPECIFIC_OPTIONS # dummy
	def_bool y

endif
```

## configs/sun60iw2p1_t736_nor_defconfig
```kconfig
CONFIG_SUNXI_TEXT_SIZE=0x150000
CONFIG_RESERVE_FDT_SIZE=0x80000
CONFIG_ARM=y
CONFIG_ARM_SMCCC=y
CONFIG_SYS_TEXT_BASE=0x4A000000
CONFIG_SUNXI_SECURE_BOOT=y
CONFIG_SUNXI_WDT_V2=y
CONFIG_MACH_SUN60IW2=y
CONFIG_SUNXI_NOR_IMG=y
CONFIG_R_I2C0_ENABLE=y
CONFIG_USB0_VBUS_PIN="PL5"
CONFIG_USB1_VBUS_PIN="PL6"
CONFIG_DEFAULT_DEVICE_TREE="sun60iw2p1-soc-system"
# CONFIG_SYS_MALLOC_F is not set
# CONFIG_SYS_MALLOC_CLEAR_ON_INIT is not set
CONFIG_PHYS_64BIT=y
CONFIG_ANDROID_BOOT_IMAGE=y
CONFIG_SUNXI_SERIAL=y
CONFIG_ANDROID_AB=y
CONFIG_SUNXI_MAC=y
CONFIG_SUNXI_USER_KEY=y
CONFIG_SUNXI_DRM_SUPPORT=y
CONFIG_SUNXI_ANDROID_BOOT=y
CONFIG_SUNXI_VERIFY_BOOT_INFO_INSTALL=y
CONFIG_SUNXI_NECESSARY_REPLACE_FDT=y
CONFIG_SUNXI_HOMLET=y
CONFIG_RECOVERY_KEY=y
CONFIG_SUNXI_HDCP_IN_SECURESTORAGE=y
CONFIG_SUNXI_SET_EFUSE_POWER=y
CONFIG_SUNXI_RKP=y
CONFIG_CMD_FASTBOOT=y
CONFIG_CMD_PART=y
CONFIG_CMD_USB=y
CONFIG_CMD_SUNXI_TIMER=y
CONFIG_CMD_SUNXI_SPRITE=y
CONFIG_CMD_SUNXI_BURN=y
CONFIG_CMD_SUNXI_MEMTEST=y
CONFIG_LAST_PARTITION_NAME="UDISK"
CONFIG_DM=y
CONFIG_SUNXI_GPADC=y
CONFIG_CLK_SUNXI=y
CONFIG_SUNXI_DMA=y
CONFIG_AW_GPIO_V3=y
CONFIG_SYS_I2C_SUNXI=y
CONFIG_SYS_SUNXI_R_I2C0_SLAVE=0x34
CONFIG_AXP8191_SUNXI_I2C_SLAVE=0x36
CONFIG_AXP515_SUNXI_I2C_SLAVE=0x34
CONFIG_MMC=y
CONFIG_UFS=y
CONFIG_SPI_FLASH=y
CONFIG_SF_DEFAULT_MODE=0x3000
CONFIG_SF_DEFAULT_SPEED=20000000
CONFIG_SPI_SAMP_DL_EN=y
CONFIG_SPI_FLASH_ATMEL=y
CONFIG_SPI_FLASH_EON=y
CONFIG_SPI_FLASH_GIGADEVICE=y
CONFIG_SPI_FLASH_ISSI=y
CONFIG_SPI_FLASH_MACRONIX=y
CONFIG_SPI_FLASH_SPANSION=y
CONFIG_SPI_FLASH_STMICRO=y
CONFIG_SPI_FLASH_SST=y
CONFIG_SPI_FLASH_WINBOND=y
CONFIG_SPI_FLASH_XMC=y
CONFIG_SPI_FLASH_PUYA=y
CONFIG_SPI_FLASH_FM=y
CONFIG_SPI_FLASH_XT=y
CONFIG_SPI=y
CONFIG_SUNXI_SPI=y
CONFIG_SUNXI_POWER=y
CONFIG_SUNXI_PMU=y
CONFIG_SUNXI_BMU=y
CONFIG_AXP515_POWER=y
CONFIG_AXP8191_POWER=y
CONFIG_SUNXI_UBOOT_POWER_OFF=y
CONFIG_USB=y
CONFIG_USB_EHCI_HCD=y
CONFIG_USB_STORAGE=y
CONFIG_AW_DRM=y
CONFIG_AW_DRM_LVDS=y
CONFIG_AW_DRM_DSI=y
CONFIG_AW_DRM_AMP_COMMUNICATTION=y
CONFIG_AW_DRM_AMP_SHARE_MEM_ADDR=0x56810000
CONFIG_AW_DRM_AMP_SHARE_MEM_SIZE=0x1000
# CONFIG_AW_DRM_EINK200 is not set
CONFIG_AW_DRM_PANEL=y
CONFIG_PANEL_DSI_GENERAL=y
CONFIG_PANEL_LVDS_GENERAL=y
CONFIG_AW_DRM_PHY=y
CONFIG_SPINOR_UBOOT_OFFSET=512
CONFIG_SPINOR_LOGICAL_OFFSET=3296
CONFIG_SUNXI_SDMMC=y
CONFIG_SUNXI_BOOT0_SDMMC_BACKUP_START_ADDR=2064
CONFIG_SUNXI_UFS=y
CONFIG_SUNXI_USB=y
CONFIG_SUNXI_EFEX=y
CONFIG_SUNXI_BURN=y
CONFIG_SUNXI_CE_30=y
CONFIG_SUNXI_PHY_KEY=y
CONFIG_SUNXI_LRADC_KEY=y
CONFIG_SUNXI_GPADC_KEY=y
CONFIG_SUNXI_ARISC_EXIST=y
CONFIG_ARISC_DEASSERT_BEFORE_KERNEL=y
CONFIG_HWSPINLOCK=y
CONFIG_CMD_SUNXI_HWSPINLOCK=y
CONFIG_SUNXI_ANDROID_OVERLAY=y
CONFIG_SUNXI_SPRITE=y
CONFIG_SUNXI_SPRITE_CARTOON=y
CONFIG_SUNXI_SPRITE_LED=y
CONFIG_SUNXI_BOOT_PARAM=y
CONFIG_SUNXI_COMP_GZ=y
CONFIG_SUNXI_UPDATE_GPT=y
```

## drivers/net/dwmac/Kconfig
```kconfig
config AW_DWMAC
	bool "Allwinner DWMAC driver"
	select NET
	select NETDEVICES
	select NET_RANDOM_ETHADDR
	select PHYLIB
	select PHY_GIGE
	select DWC_ETH_QOS_AW
	select CMD_MII
	select CMD_NET
	select CMD_TFTPBOOT
	select NET_TFTP_VARS
	select CMD_PING
	help
	 Support for Allwinner DWMAC controllers.

if AW_DWMAC
config DWC_ETH_QOS_AW
	bool "Synopsys DWC Ethernet QOS device support for Allwinner"
	depends on !DWC_ETH_QOS
	help
	 The Synopsys Designware Ethernet QOS IP block with the specific
	 configuration used in Allwinner GMAC-1XX/2XX soc.
endif
```

## drivers/sunxi_flash/Kconfig
```kconfig
menuconfig SUNXI_FLASH
	bool "Sunxi flash support"

if SUNXI_FLASH

source "drivers/sunxi_flash/nand/Kconfig"
source "drivers/sunxi_flash/spinor/Kconfig"
source "drivers/sunxi_flash/mmc/Kconfig"
source "drivers/sunxi_flash/ufs/Kconfig"


endif

config SUNXI_DUAL_STORAGE
	bool "Support sunxi dual storage"
	depends on SUNXI_FLASH
	default n
	help
	  Enable support for sunxi dual storage, for example SPI-Nor + eMMC.
	  This permits booting BOOT0/U-Boot from SPI-Nor flash, and loading kernel/rootfs from eMMC.
```

## drivers/sunxi_power/Kconfig
```kconfig
menuconfig SUNXI_POWER
	bool "Sunxi power device support"
if SUNXI_POWER

config SUNXI_PMU
	bool "Sunxi pmu support"
	---help---
	Select this to enable support for PMU
config SUNXI_BMU
	bool "Sunxi bmu support"
	---help---
	Select this to enable support for BMU
config SUNXI_PMU_EXT
	bool "Sunxi pmu_ext support"
	---help---
	Select this to enable support for PMU_EXT
config SUNXI_PMU_GENERAL
	bool "Sunxi pmu_general support"
	---help---
	Select this to enable support for CONFIG_SUNXI_PMU_GENERAL
config SUNXI_BMU_EXT
	bool "Sunxi bmu_ext support"
	---help---
	Select this to enable support for BMU_EXT

config SUNXI_TRY_POWER_SPLY
	bool "try power sply"
	depends on SUNXI_PMU
	---help---
	Try to find for example axp806_power_sply

config AXPNULL_POWER
	bool "axpdummy support board without a pmic"
	depends on SUNXI_PMU
	---help---
	Select this for boards which do not use a PMIC.

config AXP858_POWER
	bool "pmu axp858 pmic support"
	depends on SUNXI_PMU
	select AXP_PMIC_BUS
	select CMD_POWEROFF
	---help---
	Say y here to enable support for the axp858 pmic found on some
	A50 PMU dev board

config AXP515_POWER
	bool "bmu axp515 pmic support"
	depends on SUNXI_BMU
	select AXP_PMIC_BUS
	select CMD_POWEROFF
	---help---
	Say y here to enable support for the axp515 pmic found on some
	A50 BMU dev board

config AXP517_POWER
	bool "bmu axp517 pmic support"
	depends on SUNXI_BMU
	select AXP_PMIC_BUS
	select CMD_POWEROFF
	---help---
	Say y here to enable support for the axp517 pmic found on some
	A50 BMU dev board

config AXP2101_POWER
	bool "pmu/bmu axp2101 pmic support"
	depends on SUNXI_PMU
	select AXP_PMIC_BUS
	select CMD_POWEROFF
	---help---
	Say y here to enable support for the axp21 pmic found on some
	sun8iw19p1 PMU/BMU dev board

config AXP2202_POWER
	bool "pmu/bmu axp2202 pmic support"
	depends on SUNXI_PMU
	select AXP_PMIC_BUS
	select CMD_POWEROFF
	---help---
	Say y here to enable support for the axp2202 pmic found on some
	sun50iw10p1 PMU/BMU dev board

config AXP8191_POWER
	bool "pmu/bmu axp8191 pmic support"
	depends on SUNXI_PMU
	select AXP_PMIC_BUS
	select CMD_POWEROFF
	---help---
	Say y here to enable support for the axp8191 pmic found on some
	sun55iw3p1 PMU dev board

config SUNXI_AXP152_POWER
	bool "pmu axp152 pmic support"
	depends on SUNXI_PMU
	select AXP_PMIC_BUS
	select CMD_POWEROFF
	---help---
	Say y here to enable support for the axp152 pmic found on some
	sun50iw9p1 PMU dev board

config AXP1530_POWER
	bool "pmu axp1530 pmic support"
	depends on SUNXI_PMU
	select AXP_PMIC_BUS
	select CMD_POWEROFF
	---help---
	Say y here to enable support for the axp1530 pmic found on some
	sun50iw9p1 PMU dev board

config AXP81X_POWER
	bool "pmu axp81X pmic support"
	depends on SUNXI_PMU
	select AXP_PMIC_BUS
	select CMD_POWEROFF
	---help---
	Say y here to enable support for the axp81X pmic found on some
	sun50iw10p1 PMU/PMU dev board

config AXP806_POWER
	bool "pmu axp806 pmic support"
	depends on SUNXI_PMU
	select AXP_PMIC_BUS
	select CMD_POWEROFF
	---help---
	Say y here to enable support for the axp81X pmic found on some
	sun50iw9p1 PMU dev board

config AXP221_POWER_SUNXI
	bool "pmu axp221 pmic support"
	depends on SUNXI_PMU
	select AXP_PMIC_BUS
	select CMD_POWEROFF
	---help---
	Say y here to enable support for the axp221 pmic found on some
	sun8iw11p1 PMU dev board

config TCS4838_POWER
	bool "pmu tcs4838 pmic support"
	depends on SUNXI_PMU
	select AXP_PMIC_BUS
	select CMD_POWEROFF
	---help---
	Say y here to enable support for the tcs4838 pmic found on some
	sun50iw10p1 PMU dev board, with axp2202

config SY8827G_POWER
	bool "pmu sy8827g pmic support"
	depends on SUNXI_PMU
	select AXP_PMIC_BUS
	select CMD_POWEROFF
	---help---
	Say y here to enable support for the sy8827g pmic found on some
	sun50iw10p1 PMU dev board, with axp2202

config OCP2131_POWER
	bool "pmu ocp2131 pmic support"
	depends on SUNXI_PMU_GENERAL
	select AXP_PMIC_BUS
	select CMD_POWEROFF
	---help---
	Say y here to enable support for the ocp2131 pmic

config AW37501_POWER
	bool "pmu aw37501 pmic support"
	depends on SUNXI_PMU_GENERAL
	select AXP_PMIC_BUS
	select CMD_POWEROFF
	---help---
	Say y here to enable support for the aw37501 pmic

config ETA6973_POWER
	bool "bmu eta6973 pmic support"
	depends on SUNXI_BMU_EXT
	select AXP_PMIC_BUS
	select CMD_POWEROFF
	---help---
	Say y here to enable support for the eta6973 pmic found on some
	sun55iw3p1 PMU dev board, with axp2202

config AXP519_POWER
	bool "bmu axp519 pmic support"
	depends on SUNXI_BMU_EXT
	select AXP_PMIC_BUS
	select CMD_POWEROFF
	---help---
	Say y here to enable support for the axp519 & axp2601 pmic found on some
	sun55iw3p1 PMU dev board, with axp2202

config AXP2601_POWER
	bool "bmu axp2601 pmic support"
	depends on SUNXI_BMU
	select AXP_PMIC_BUS
	select CMD_POWEROFF
	---help---
	Say y here to enable support for the single axp2601 pmic

config SUNXI_UBOOT_POWER_OFF
	bool "Sunxi uboot power off"
	---help---
	Select this to enable support for uboot power off

config SUNXI_GPIO_NOT_CTRL_BY_POWER
	default y if SUNXI_GPIO_POWER_VOL_MODE
	bool "Sunxi gpio function not control by power manager"
	---help---
	Select this to disable power manager control gpio

endif
```

## drivers/ufs/Kconfig
```kconfig
menu "UFS Host controller Support"

config UFS
	bool "UFS  support"
	#default ARM || PPC || SANDBOX
	default n
	select HAVE_BLOCK_DEVICE
	#select CMD_MMC
	help
	  This selects UFS.

	  If you want UFS, you should say Y here and
	  also to your specific host controller driver.
endmenu
```

## drivers/video/drm/panels/Kconfig
```kconfig
menuconfig AW_DRM_PANEL
	tristate "Support panel based on DRM framework"
	depends on AW_DRM
	select PANEL
	select SUNXI_PMU_GENERAL
	default n
	help
		If you want use DRM panel, select it.

config PANEL_DSI_GENERAL
	bool "dsi general panel"
	depends on  AW_DRM_PANEL && AW_DRM_DSI
	default n
	help
		If you want to support general dsi panel, select it.

config PANEL_LVDS_GENERAL
	bool "lvds general panel"
	depends on (AW_DRM_PANEL)
	default n
	help
		If you want to support general lvds panel, select it.

config PANEL_RGB_GENERAL
	bool "rgb general panel"
	depends on AW_DRM_PANEL && AW_DRM_RGB
	default n
	help
		If you want to support general rgb panel, select it.

config PANEL_EDP_GENERAL
    tristate "eDP general drm panel"
	depends on (AW_DRM_PANEL)
	select VIDEOMODE_HELPERS
    default n
    help
        If you want to support general edp panel, select it.

config PANEL_ES103TC1C1
	bool "ES103TC1C1 eink panel"
	depends on AW_DRM_PANEL && AW_DRM_EINK200
	select VIDEOMODE_HELPERS
	default n
	help
		If you want to support ES103TC1C1 panel, select it.
```
